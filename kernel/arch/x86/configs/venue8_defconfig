## kernel/arch/x86/configs/venue8_defconfig
```kconfig
#
# Dell Venue 8 3840 (Merrifield/Saltbay) defconfig
#
# Based on x86_64_defconfig + Intel MID + Venue 8 board support
# Kernel 6.6 for Android 15
#

CONFIG_64BIT=y
CONFIG_SMP=y
CONFIG_PREEMPT=y
CONFIG_HIGH_RES_TIMERS=y

# PCI (Merrifield is entirely PCI-enumerated)
CONFIG_PCI=y
CONFIG_PCI_MSI=y

# Intel MID platform
CONFIG_X86_EXTENDED_PLATFORM=y
CONFIG_X86_PLATFORM_DEVICES=y
CONFIG_X86_INTEL_MID=y
CONFIG_DELL_VENUE8_3840=y
CONFIG_X86_IO_APIC=y

# SCU IPC (PMIC access, power management)
CONFIG_INTEL_SCU_IPC=y
CONFIG_INTEL_SCU_PCI=y
CONFIG_INTEL_SCU_IPC_UTIL=m

# Basin Cove PMIC
CONFIG_MFD_INTEL_MSIC=y
CONFIG_INTEL_SOC_PMIC_MRFLD=y

# Pin control
CONFIG_PINCTRL=y
CONFIG_PINCTRL_INTEL=y
CONFIG_PINCTRL_MERRIFIELD=y

# GPIO
CONFIG_GPIOLIB=y

# I2C (Designware controllers on Merrifield)
CONFIG_I2C=y
CONFIG_I2C_DESIGNWARE_CORE=y
CONFIG_I2C_DESIGNWARE_PLATFORM=y
CONFIG_I2C_DESIGNWARE_PCI=y
CONFIG_I2C_CHARDEV=y

# SPI
CONFIG_SPI=y
CONFIG_SPI_PXA2XX=y
CONFIG_SPI_PXA2XX_PCI=y

# USB
CONFIG_USB=y
CONFIG_USB_EHCI_HCD=y
CONFIG_USB_EHCI_PCI=y
CONFIG_USB_EHCI_ROOT_HUB_TT=y
CONFIG_USB_DWC3=y
CONFIG_USB_DWC3_PCI=y
CONFIG_USB_DWC3_GADGET=y
CONFIG_USB_DWC3_DUAL_ROLE=y
CONFIG_USB_ACM=y
CONFIG_USB_CDC_NCM=m

# Venue 8 modem and HSIC
CONFIG_DELL_VENUE8_MODEM_CONTROL=m
CONFIG_DELL_VENUE8_EHCI_HSIC=m

# Serial / TTY
CONFIG_SERIAL_8250=y
CONFIG_SERIAL_8250_PCI=y
CONFIG_SERIAL_8250_MID=y
CONFIG_N_GSM=m

# WiFi (BCM4335 via brcmfmac)
CONFIG_CFG80211=m
CONFIG_MAC80211=m
CONFIG_BRCMUTIL=m
CONFIG_BRCMFMAC=m
CONFIG_BRCMFMAC_SDIO=y

# Bluetooth (BCM4335)
CONFIG_BT=m
CONFIG_BT_HCIUART=m
CONFIG_BT_HCIUART_BCM=y
CONFIG_BT_BCM=m

# Sensors (IIO)
CONFIG_IIO=y
CONFIG_IIO_BUFFER=y
CONFIG_IIO_TRIGGER=y
CONFIG_IIO_ST_SENSORS_CORE=m
CONFIG_IIO_ST_SENSORS_I2C=m
CONFIG_IIO_ST_ACCEL_3AXIS=m
CONFIG_IIO_ST_ACCEL_I2C_3AXIS=m
CONFIG_IIO_ST_MAGN_3AXIS=m
CONFIG_IIO_ST_MAGN_I2C_3AXIS=m
CONFIG_IIO_ST_GYRO_3AXIS=m
CONFIG_IIO_ST_GYRO_I2C_3AXIS=m
CONFIG_IIO_ST_LSM6DSX=m
CONFIG_IIO_ST_LSM6DSX_I2C=m

# Audio
CONFIG_SOUND=y
CONFIG_SND=y
CONFIG_SND_SOC=y
CONFIG_SND_SOC_INTEL_SST_TOPLEVEL=y
CONFIG_SND_SST_ATOM_HIFI2_PLATFORM=m
CONFIG_SND_SST_ATOM_HIFI2_PLATFORM_PCI=m
CONFIG_SND_SOC_INTEL_MRFLD_WM8958_MACH=m
CONFIG_SND_SOC_WM8994=m
CONFIG_MFD_WM8994=m
CONFIG_REGULATOR_WM8994=m

# Regulators (for WM8994 codec supplies)
CONFIG_REGULATOR=y
CONFIG_REGULATOR_FIXED_VOLTAGE=y

# Power supply
CONFIG_POWER_SUPPLY=y
CONFIG_BATTERY_BQ27XXX=m
CONFIG_BATTERY_BQ27XXX_I2C=m
CONFIG_CHARGER_BQ24257=m

# GPIO keys (volume buttons)
CONFIG_KEYBOARD_GPIO=y

# LEDs
CONFIG_NEW_LEDS=y
CONFIG_LEDS_CLASS=y
CONFIG_LEDS_GPIO=y
CONFIG_LEDS_TRIGGERS=y

# Touchscreen
CONFIG_TOUCHSCREEN_ELAN=m
CONFIG_RMI4_CORE=m
CONFIG_RMI4_I2C=m
CONFIG_RMI4_F11=y
CONFIG_RMI4_F12=y

# Display (framebuffer for early bringup)
CONFIG_FB=y
CONFIG_FB_SIMPLE=y
CONFIG_FRAMEBUFFER_CONSOLE=y
CONFIG_DRM=y
CONFIG_DRM_SIMPLEDRM=y
CONFIG_SYSFB=y
CONFIG_SYSFB_SIMPLEFB=y

# Camera (atomisp ISP2400 for Merrifield)
CONFIG_STAGING=y
CONFIG_STAGING_MEDIA=y
CONFIG_X86_INTEL_LPSS=y
CONFIG_MEDIA_SUPPORT=y
CONFIG_MEDIA_CAMERA_SUPPORT=y
CONFIG_MEDIA_PCI_SUPPORT=y
CONFIG_MEDIA_CONTROLLER=y
CONFIG_VIDEO_DEV=y
CONFIG_VIDEO_V4L2_SUBDEV_API=y
CONFIG_INTEL_ATOMISP=y
CONFIG_IPU_BRIDGE=m
CONFIG_PMIC_OPREGION=y
CONFIG_VIDEO_ATOMISP=m
# CONFIG_VIDEO_ATOMISP_ISP2401 is not set

# eMMC
CONFIG_MMC=y
CONFIG_MMC_SDHCI=y
CONFIG_MMC_SDHCI_PCI=y

# Filesystem
CONFIG_EXT4_FS=y
CONFIG_VFAT_FS=y
CONFIG_TMPFS=y
CONFIG_PROC_FS=y
CONFIG_SYSFS=y

# Android requirements
CONFIG_ANDROID=y
CONFIG_ANDROID_BINDER_IPC=y
CONFIG_ASHMEM=y
CONFIG_ANDROID_BINDERFS=y

# Security
CONFIG_SECURITY=y
CONFIG_SECURITYFS=y
CONFIG_SECURITY_SELINUX=y

# EXTCON (required by BQ24257 charger)
CONFIG_EXTCON=y

# Networking
CONFIG_NET=y
CONFIG_INET=y
CONFIG_IPV6=y
CONFIG_NETFILTER=y

# Debug (remove for production)
CONFIG_PRINTK=y
CONFIG_EARLY_PRINTK=y
CONFIG_DYNAMIC_DEBUG=y
CONFIG_DEBUG_INFO=y
CONFIG_MAGIC_SYSRQ=y
CONFIG_USB_SERIAL=m
CONFIG_USB_SERIAL_GENERIC=y
```

## kernel/drivers/gpu/drm/venue8/Kconfig
```kconfig
config DRM_VENUE8_DISPLAY
	tristate "Dell Venue 8 3840 Tangier MIPI DSI display"
	depends on DRM && PCI && X86
	select DRM_KMS_HELPER
	select DRM_GEM_SHMEM_HELPER
	help
	  DRM driver for the Dell Venue 8 3840's MIPI DSI display panel
	  (1200x1920 AUO/Innolux). The display controller is part of the
	  Merrifield (Tangier) SoC's PowerVR G6400 GPU PCI device.

	  This driver provides a simple framebuffer console via
	  drm_simple_display_pipe. It does not provide GPU acceleration.

	  If unsure, say N.
```

## kernel/drivers/misc/venue8/Kconfig
```kconfig
config DELL_VENUE8_MODEM_CONTROL
	tristate "Dell Venue 8 3840 modem control driver"
	depends on X86_INTEL_MID
	depends on INTEL_SCU_IPC
	depends on GPIOLIB
	help
	  Control driver for the Intel XMM 7160 LTE modem on the Dell
	  Venue 8 3840 tablet. Manages modem power via GPIO and Basin Cove
	  PMIC, and provides /dev/mdm_ctrl for the userspace modem manager
	  (mmgr) to control modem state.

	  To compile this driver as a module, choose M here: the module
	  will be called modem_control.

config DELL_VENUE8_EHCI_HSIC
	tristate "Dell Venue 8 3840 EHCI HSIC companion driver"
	depends on X86_INTEL_MID
	depends on USB_EHCI_PCI
	help
	  Companion driver for the EHCI HSIC controller that connects
	  to the Intel XMM 7160 modem on the Dell Venue 8 3840. Provides
	  HSIC PHY initialization and sysfs interface for the modem
	  manager (mmgr) to enable/disable the USB link.

	  To compile this driver as a module, choose M here: the module
	  will be called ehci_hsic.

config DELL_VENUE8_CAMERA
	tristate "Dell Venue 8 3840 camera platform glue"
	depends on X86_INTEL_MID
	depends on INTEL_SCU_IPC
	depends on VIDEO_ATOMISP || VIDEO_V4L2
	depends on GPIOLIB
	help
	  Camera sensor platform glue for the Dell Venue 8 3840.
	  Provides power sequencing, clock control, and CSI-2 configuration
	  callbacks for the OV5693 (rear, 5MP) and OV2722 (front, 2MP)
	  cameras connected to the Merrifield ISP2400 via MIPI CSI-2.

	  To compile this driver as a module, choose M here: the module
	  will be called venue8_camera.
```
